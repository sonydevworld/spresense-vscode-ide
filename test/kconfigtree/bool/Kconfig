## test/kconfigtree/bool/Kconfig
```kconfig
menu "Boolean"

comment "prompt option"

config BOOL_POMPT
	bool
	prompt "The boolean config"

config BOOL_PROMPT_IF_Y
	bool
	prompt "The boolean config" if BOOL_DEF_Y
	default y

config BOOL_PROMPT_IF_N
	bool
	prompt "The boolean config" if BOOL_DEF_N
	default y

config BOOL
	bool "The boolean config"

config BOOL_HIDDEN
	bool
	default y

comment "default option"

config BOOL_DEF_Y
	bool "This config should be y"
	default y

config BOOL_DEF_N
	bool
	default n

config BOOL_DEF_OTHERS
	bool "This config is the same as above"
	default BOOL_DEF_Y

config BOOL_DEF_IF_Y
	bool "This config should be y"
	default y if BOOL_DEF_Y

config BOOL_DEF_IF_N
	bool "This config should be n"
	default y if BOOL_DEF_N

config BOOL_DEF_MULTIPLE
	bool "This config should be y"
	default y
	default n

config BOOL_DEF_MULTIPLE_OTHERS
	bool "This config should be y"
	default BOOL_DEF_Y
	default BOOL_DEF_N

config BOOL_DEF_MULTIPLE_IF_Y
	bool "This config should be n"
	default n if BOOL_DEF_Y
	default y if BOOL_DEF_N

config BOOL_DEF_MULTIPLE_IF_ALL_Y
	bool "This config should be n"
	default n if BOOL_DEF_Y
	default y if BOOL_DEF_Y

config BOOL_DEF_MULTIPLE_IF_ALL_N
	bool "This config should be n"
	default y if BOOL_DEF_N
	default y if BOOL_DEF_N

comment "depends on option"

config BOOL_DEP_Y
	bool "This config depends on others"
	depends on BOOL_DEF_Y

config BOOL_DEP_N
	bool "This config is disabled"
	depends on BOOL_DEF_N

comment "select option"

config BOOL_SELECT
	bool "Select below"
	select BOOL_SELECTED

config BOOL_SELECTED
	bool "Selected by above"

config BOOL_SELECT_IF_Y
	bool "Select below if y"
	select BOOL_SELECTED_IF if BOOL_DEF_Y

config BOOL_SELECTED_IF_Y
	bool "Selected by above"

config BOOL_SELECT_IF_N
	bool "Select below if n"
	select BOOL_SELECTED_IF_N if BOOL_DEF_N

config BOOL_SELECTED_IF_N
	bool "Selected by above"

comment "imply option"

config BOOL_IMPLY
	bool "Imply below"
	imply BOOL_IMPLIED

config BOOL_IMPLIED
	bool "Implied by above"

config BOOL_IMPLY_IF_Y
	bool "Imply below if"
	imply BOOL_IMPLIED_IF if BOOL_DEF_Y

config BOOL_IMPLIED_IF_Y
	bool "Implied by above"

config BOOL_IMPLY_IF_N
	bool "Imply below if n"
	imply BOOL_IMPLIED_IF_N if BOOL_DEF_N

config BOOL_IMPLIED_IF_N
	bool "Imply below if n"

config BOOL_IMPLY_DEP
	bool "Imply below"
	imply BOOL_IMPLIED_DEP

config BOOL_IMPLIED_DEP
	bool "Implied by above"
	depends on BOOL_DEF_Y

endmenu
```

## test/kconfigtree/choice/Kconfig
```kconfig
menu "Choice"

choice CHOICE
	prompt "The choice"
config CI_FOO
	bool "FOO"
config CI_BAR
	bool "BAR"
config CI_BAZ
	bool "BAZ"
endchoice

choice CHOICE_NODEF
	prompt "Without default"
config CI_NODEF_FOO
	bool "FOO"
config CI_NODEF_BAR
	bool "BAR"
config CI_NODEF_BAZ
	bool "BAZ"
endchoice

choice CHOICE_DEF
	prompt "With default"
	default CI_DEF_FOO
config CI_DEF_FOO
	bool "FOO"
config CI_DEF_BAR
	bool "BAR"
config CI_DEF_BAZ
	bool "BAZ"
endchoice

choice CHOICE_DEP
	prompt "FOO is depended by below"
config CI_DEP_FOO
	bool "FOO"
config CI_DEP_BAR
	bool "BAR"
config CI_DEP_BAZ
	bool "BAZ"
endchoice

config CHOICE_DEPENDS
	bool "This config enabled by FOO in above"
	depends on CI_DEP_FOO

choice CHOICE_SELECT
	prompt "FOO is select below"
config CI_SELECT_FOO
	bool "FOO"
	select CHOICE_SELECTED
config CI_SELECT_BAR
	bool "BAR"
config CI_SELECT_BAZ
	bool "BAZ"
endchoice

choice CHOICE_DEP_ITEM
	prompt "FOO, BAR is depends on below"
config CI_DEP_ITEM_FOO
	bool "FOO"
	depends on CHOICE_DEP_ITEM_Y
config CI_DEP_ITEM_BAR
	bool "BAR"
	depends on CHOICE_DEP_ITEM_N
config CI_DEP_ITEM_BAZ
	bool "BAZ"
endchoice

config CHOICE_DEP_ITEM_Y
	bool "depended by above (y)"
	default y

config CHOICE_DEP_ITEM_N
	bool "depended by above (n)"
	default n

choice CHOICE_NOTYPE_BOOL
	prompt "This config should be bool"
config CI_NOTYPE_BOOL_FOO
	bool "FOO"
config CI_NOTYPE_BOOL_BAR
	bool "BAR"
config CI_NOTYPE_BOOL_BAZ
	bool "BAZ"
endchoice

#choice CHOICE_NOTYPE_TRI
#	prompt "This config should be bool"
#config CI_NOTYPE_TRI_FOO
#	tristate "FOO"
#config CI_NOTYPE_TRI_BAR
#	tristate "BAR"
#config CI_NOTYPE_TRI_BAZ
#	tristate "BAZ"
#endchoice

#choice CHOICE_TRI
#	prompt "tristate type"
#	tristate
#config CI_TRI_FOO
#	tristate "FOO"
#config CI_TRI_BAR
#	tristate "BAR"
#config CI_TRI_BAZ
#	tristate "BAZ"
#endchoice

endmenu
```

## test/kconfigtree/expr/Kconfig
```kconfig
config SYMBOL_BOOL_Y
	bool
	default y

config SYMBOL_BOOL_N
	bool
	default n

#config SYMBOL_TRI_Y
#	tristate
#	default y

#config SYMBOL_TRI_M
#	tristate
#	default m

#config SYMBOL_TRI_N
#	tristate
#	default n

config SYMBOL_INT_1024
	int
	default 1024

config SYMBOL_HEX_0X100
	hex
	default 0x100

config SYMBOL_STR_HELLO
	string
	default "hello"
```

## test/kconfigtree/hex/Kconfig
```kconfig
menu "Hex"

comment "prompt option"

config HEX_PROMPT
	hex
	prompt "The hex config"

config HEX_PROMPT_IF_Y
	hex
	prompt "The hex config" if y

config HEX_PROMPT_IF_N
	hex
	prompt "The hex config" if n

config HEX
	hex "The hex config"

config HEX_HIDDEN
	hex
    default 0x0

comment "default option"

config HEX_DEF
	hex "This config should be 0x9999"
	default 0x9999

config HEX_DEF_OTHERS
	hex "This config is the same as above"
	default HEX_DEF

config HEX_DEF_IF_Y
	hex "This config should be 0x999"
	default 0x999 if y

config HEX_DEF_IF_N
	hex "This config should be empty"
	default 0x999 if n

config HEX_DEF_MULTIPLE
	hex "This config should be 0x999"
	default 0x999
	default 0x123

config HEX_DEF_MULTIPLE_OTHERS
	hex "This config should be 0x9999"
	default HEX_DEF
	default HEX_DEF_IF_Y

config HEX_DEF_MULTIPLE_IF_Y
	hex "This config should be 0x999"
	default HEX_DEF if n
	default HEX_DEF_IF_Y if y

config HEX_DEF_MULTIPLE_IF_ALL_Y
	hex "This config should be 0x9999"
	default HEX_DEF if y
	default HEX_DEF_IF_Y if y

config HEX_DEF_MULTIPLE_IF_ALL_N
	hex "This config should be empty"
	default HEX_DEF if n
	default HEX_DEF_IF_Y if n

comment "depends on option"

config HEX_DEP_Y
	hex "This config depends on others"
	depends on HEX_DEPENDED_Y
	default 0x100

config HEX_DEP_N
	hex "This config is disabled"
	depends on HEX_DEPENDED_N
	default 0x100

config HEX_DEPENDED_Y
	bool
	default y

config HEX_DEPENDED_N
	bool
	default n

comment "range option"

config HEX_RANGE_LOW
	hex "Low value of range symbol"
	default 0x10

config HEX_RANGE_HIGH
	hex "High value of range symbol"
	default 0x100

config HEX_RANGE_CONST_CONST
	hex "This config should be 0x100"
	range 0x10 0x100
    default 0x1000

config HEX_RANGE_CONST_SYM
	hex "This config should be 0x100"
	range 0x10 HEX_RANGE_HIGH
	default 0x1000

config HEX_RANGE_SYM_CONST
	hex "This config should be 0x100"
	range HEX_RANGE_LOW 0x100
	default 0x0

config HEX_RANGE_SYM_SYM
	hex "This config should be 0x10"
	range HEX_RANGE_LOW HEX_RANGE_HIGH
	default 0x0

config HEX_RANGE_IF_Y
	hex "This value should be 100"
	range 0x10 0x100 if y
	default 0x0

config HEX_RANGE_IF_N
	hex "This value should be 0"
	range 0x10 0x100 if n
	default 0x0

config HEX_RANGE_MULTIPLE
	hex "This value should be 0x100"
	range 0x10 0x100
	range 0x200 0x300
	default 0x12345

config HEX_RANGE_MULTIPLE_IF_Y
	hex "This value should be 0x300"
	range 0x10 0x100 if n
	range 0x200 0x300 if y
	default 0x12345

config HEX_RANGE_MULTIPLE_IF_ALL_Y
	hex "This value should be 0x100"
	range 0x10 0x100 if y
	range 0x200 0x300 if y
	default 0x12345

config HEX_RANGE_MULTIPLE_IF_ALL_N
	hex "This value should be 0"
	range 0x10 0x100 if n
	range 0x200 0x300 if n
	default 0

endmenu
```

## test/kconfigtree/int/Kconfig
```kconfig
menu "Int"

comment "prompt option"

config INT_PROMPT
	int
	prompt "The int config"

config INT_PROMPT_IF_Y
	int
	prompt "The int config" if y

config INT_PROMPT_IF_N
	int
	prompt "The int config" if n

config INT
	int "The int config"

config INT_HIDDEN
	int
	default 0

comment "default option"

config INT_DEF
	int "With default value"
	default 9999

config INT_DEF_OTHERS
	int "This value same as above"
	default INT_DEF

config INT_DEF_IF_Y
	int "this config should be 999"
	default 999 if y

config INT_DEF_IF_N
	int "this config should be empty"
	default 999 if n

config INT_DEF_MULTIPLE
	int "this config should be 999"
	default 999
	default 123

config INT_DEF_MULTIPLE_OTHERS
	int "this config should be 9999"
	default INT_DEF
	default INT_DEF_IF_Y

config INT_DEF_MULTIPLE_IF_Y
	int "this config should be 999"
	default INT_DEF if n
	default INT_DEF_IF_Y if y

config INT_DEF_MULTIPLE_IF_ALL_Y
	int "this config should be 9999"
	default INT_DEF if y
	default INT_DEF_IF_Y if y

config INT_DEF_MULTIPLE_IF_ALL_N
	int "this config should be empty"
	default INT_DEF if n
	default INT_DEF_IF_Y if n

comment "depends on option"

config INT_DEP_Y
	int "This config depends on others"
	depends on INT_DEPENDED_Y
	default 100

config INT_DEP_N
	int "This config depends on others"
	depends on INT_DEPENDED_N
	default 100

config INT_DEPENDED_Y
	bool
	default y

config INT_DEPENDED_N
	bool
	default n

comment "range option"

config INT_RANGE_LOW
	int "Low value of range symbol"
	default 10

config INT_RANGE_HIGH
	int "High value of range symbol"
	default 100

config INT_RANGE_CONST_CONST
	int "With range option"
	range 100 200
	default 1000

config INT_RANGE_CONST_SYM
	int "With range option"
	range 100 INT_RANGE_HIGH
	default 1000

config INT_RANGE_SYM_CONST
	int "With range option"
	range INT_RANGE_LOW 100
	default 0

config INT_RANGE_SYM_SYM
	int "With range option"
	range INT_RANGE_LOW INT_RANGE_HIGH
	default 0

config INT_RANGE_IF_Y
	int "This value should be 100"
	range 100 1000 if y
	default 0

config INT_RANGE_IF_N
	int "This value should be 0"
	range 100 1000 if n
	default 0

config INT_RANGE_MULTIPLE
	int "This value should be 1000"
	range 100 1000
	range 2000 3000
	default 12345

config INT_RANGE_MULTIPLE_IF_Y
	int "This value should be 3000"
	range 100 1000 if n
	range 2000 3000 if y
	default 12345

config INT_RANGE_MULTIPLE_IF_ALL_Y
	int "This value should be 1000"
	range 100 1000 if y
	range 2000 3000 if y
	default 12345

config INT_RANGE_MULTIPLE_IF_ALL_N
	int "This value should be 0"
	range 100 1000 if n
	range 2000 3000 if n
	default 0

endmenu
```

## test/kconfigtree/string/Kconfig
```kconfig
menu "String"

comment "prompt option"

config STR_PROMPT
	string
	prompt "The string config"

config STR_PROMPT_IF_Y
	string
	prompt "The string config" if y

config STR_PROMPT_IF_N
	string
	prompt "This config not shown" if n

config STR
	string "The string config"

config STR_HIDDEN
	string
	default "This config is hidden"

comment "default option"

config STR_DEF
	string "This config should be hello, world"
	default "hello, world"

config STR_DEF_OTHERS
	string "This config is the same as above"
	default STR_DEF

config STR_DEF_IF_Y
	string "This config should be hello, world"
	default "hello, world" if y

config STR_DEF_IF_N
	string "This config should be empty"
	default "hello, world" if n

config STR_DEF_MULTIPLE
	string "This config should be hello"
	default "hello"
	default "world"

config STR_DEF_MULTIPLE_OTHERS
	string "This config should be hello"
	default STR_DEF
	default STR

config STR_DEF_MULTIPLE_IF_Y
	string "This config should be world"
	default "hello" if n
	default "world" if y

config STR_DEF_MULTIPLE_IF_ALL_Y
	string "This config should be hello"
	default "hello" if y
	default "world" if y

config STR_DEF_MULTIPLE_IF_ALL_N
	string "This config should be empty"
	default "hello" if n
	default "world" if n

comment "depends on option"

config STR_DEP_Y
	string "This config depends on others"
	depends on STR_DEPENDED_Y

config STR_DEP_N
	string "This config is disabled"
	depends on STR_DEPENDED_N

config STR_DEPENDED_Y
	bool
	default y

config STR_DEPENDED_N
	bool
	default n

endmenu
```

## test/kconfigtree/syntax/Kconfig
```kconfig
menu "Syntax"

menuconfig MENUCONFIG_BOOL_DEP
	bool "The menuconfig (bool)"
	default y

config MENUCONFIG_BOOL_DEP_ITEM
	bool "item"
	depends on MENUCONFIG_BOOL_DEP

menuconfig MENUCONFIG_BOOL_IF
	bool "The menuconfig (bool)"
	default y

if MENUCONFIG_BOOL_IF

config MENUCONFIG_BOOL_IF_ITEM
	bool "item"

endif

menuconfig MENUCONFIG_TRI_DEP
	tristate "The menuconfig (tristate)"
	default m

config MENUCONFIG_TRI_DEP_ITEM
	bool "item"
	depends on MENUCONFIG_TRI_DEP

menuconfig MENUCONFIG_TRI_IF
	tristate "The menuconfig (tristate)"
	default y

if MENUCONFIG_TRI_IF

config MENUCONFIG_TRI_IF_ITEM
	bool "item"

endif

menuconfig MENUCONFIG_STR_DEP
	string "The menuconfig (string)"
	default "hello"

config MENUCONFIG_STR_DEP_ITEM
	bool "item"
	depends on MENUCONFIG_STR_DEP = "hello"

menuconfig MENUCONFIG_STR_IF
	string "The menuconfig (string)"
	default "world"

if MENUCONFIG_STR_IF = "world"

config MENUCONFIG_STR_IF_ITEM
	bool "item"

endif

menuconfig MENUCONFIG_INT_DEP
	int "The menuconfig (int)"
	default 1

config MENUCONFIG_INT_DEP_ITEM
	bool "item"
	depends on MENUCONFIG_INT_DEP > 0

menuconfig MENUCONFIG_INT_IF
	int "The menuconfig (int)"
	default 2

if MENUCONFIG_INT_IF >= 2

config MENUCONFIG_INT_IF_ITEM
	bool "item"

endif

menuconfig MENUCONFIG_HEX_DEP
	hex "The menuconfig (hex)"
	default 0x1

config MENUCONFIG_HEX_DEP_ITEM
	bool "item"
	depends on MENUCONFIG_HEX_DEP > 0x0

menuconfig MENUCONFIG_HEX_IF
	hex "The menuconfig (hex)"
	default 0x2

if MENUCONFIG_HEX_IF >= 0x2

config MENUCONFIG_HEX_IF_ITEM
	bool "item"

endif

config COMMENT_Y
	bool
	default y

config COMMENT_N
	bool
	default n

comment "This comment should be shown"
	depends on COMMENT_Y

comment "Hidden comment"
	depends on COMMENT_N

config MENU_ENABLE
	bool
	default y

config MENU_DISABLE
	bool
	default n

menu "Enabled menu"
	depends on MENU_ENABLE

config MENU_ENABLE_ITEM
	bool "Enabled config"
	default y

endmenu

menu "Disabled menu"
	depends on MENU_DISABLE

config MENU_DISABLE_ITEM
	bool "Disabled config"
	default y

endmenu

menu "Shown menu"
	visible if MENU_ENABLE

config MENU_SHOWN_ITEM
	bool "Shown config"
	default y

endmenu

menu "Hidden menu"
	visible if MENU_DISABLE

config MENU_HIDDEN_ITEM
	bool "Hidden config"
	default y

endmenu

config IF_ENDIF
	bool "if/endif"

if IF_ENDIF

config IF_ENDIF_ITEM
	bool "if/endif block item"

endif

endmenu
```
